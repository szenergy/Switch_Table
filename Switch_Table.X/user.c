    /*
 * File:   user.c
 * Author: SZEnergy
 *
 * Created on April 21, 2020, 3:35 PM
 */

#include "user.h"


//#define TESTING
//#include "mcc_generated_files/pin_manager.h"
//#include "mcc_generated_files/adc1.h"

// ******************************
// Global user variables
// ******************************
volatile VCU_STATE_A VcuState_A;
volatile VCU_STATE_B VcuState_B;
volatile VCU_STATE_C VcuState_C;

volatile MC_STATE_1 MC_1;
volatile MC_STATE_2 MC_2;
volatile MC_Bytes MC_REF;
volatile CAN_Bytes battery_voltage;
//volatile CAN_Bytes rpm;
volatile double mc_duty_cycle;
volatile int32_t mc_data_buffer;

volatile double vcu_throttle;
volatile int32_t vcu_data_buffer;

//CAN_MSG_OBJ testmsg;
volatile CAN_MSG_OBJ VCUmsg;
volatile CAN_MSG_OBJ MCmsg;
volatile CAN_MSG_OBJ RECmsg;

volatile struct FLAGS flags;
//volatile struct VEHICLE vehicle;

//uint8_t data_test[8];
volatile uint8_t data_mc[4];
volatile uint8_t data_vcu_state[4];
volatile uint8_t data_rec_message[8];

//volatile float DISTANCE_STEP;
//volatile uint16_t battery_Voltage; 
volatile uint8_t countdown_battery_low;
volatile uint8_t counter_can_tx_100ms;
volatile uint8_t debounce_ms_counter;
volatile uint8_t debounce_timestamp;
//double SPEED_MULT_FACTOR;
//uint8_t LUT_DISTANCE_RESOLUTION;
//uint16_t LUT_SIZE;
//uint16_t RATE_LIMIT; 
//bool lut_buffer;
//int16_t acceleration_rate;
volatile uint16_t systemTimer; //for testing
//volatile uint16_t CanCounter;

volatile ADC_Bytes conversion;
volatile ADC_Bytes prev_conversion;
volatile ADC_Bytes prev_ref_conversion;
volatile uint16_t adc_delay_counter;

volatile bool prev_DC_EN;
volatile bool PGOOD;
volatile bool displayed_steeringw_installed;

//volatile uint16_t STEP;
//volatile uint16_t ZERO_REF;
//volatile uint16_t MAX_REF;
//extern uint8_t REF;

//volatile float EMA_A;
volatile uint16_t ema_s;

//Right_state = 0; Left_State = 1;
volatile uint8_t wiper_state;

//bool lut[11483] ={1,1,1,1,1,1,1,1,1,1,1,1,1,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0,0};

//uint16_t lut[116]={102,205,307,409,511,614,883,862,987,509,0,0,0,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1000,0};
//first value changed to 222 from 479 just for smoother testing
volatile uint16_t counter_buzzer_1s = 0;
volatile uint16_t counter_battery_led_500ms = 0;
volatile uint16_t counter_pgood_led_500ms = 0;


volatile enum StateMachine current_state;
volatile enum StateMachine prev_state;

// ******************************
// User functions
// ******************************

void VariableInit(void){
    VcuState_A.VCUBits_1    = 0b00000000;
    VcuState_B.VCUBits_2    = 0b00000000;
    VcuState_C.VCUBits_3    = 0b00000000;
    PortStatusUpdate();
    MC_1.MCBits_1               = 0b00000000;
    MC_2.MCBits_2               = 0b00000000;
    MC_REF.LowByte              = 0;
    MC_REF.HighByte             = 0;
    battery_voltage.Word        = 40000;
    data_mc[4]                  = 0;
    data_vcu_state[4]           = 0;
    data_rec_message[8]         = 0;
    conversion.LowByte          = 0;
    conversion.HighByte         = 0;
    adc_delay_counter           = 0;
    prev_DC_EN                  = false; 
    countdown_battery_low       = 0;
    counter_can_tx_100ms        = 0;
    debounce_ms_counter         = 0;
    debounce_timestamp          = 0;
    mc_duty_cycle               = 0.;
    mc_data_buffer              = 0;
    ema_s                       = 0;
    wiper_state                 = 0;    
    systemTimer                 = 0;
    flags.port_status_update                        = false;
    flags.debounce_protected_port_status_update     = false;
    flags.can_process_rec_msg                       = false;
    flags.can_vcu_state                             = false;
    flags.mc_command_update_and_send                = false;
    flags.pgood                                     = false;
    flags.mc_override_changed_to_1                  = false;
    flags.mc_override_changed_to_0                  = false;
    flags.can_synced                                = false;
    flags.wiper_on                                  = false;
    flags.wiper_move                                = false;
}

void PotConversion(void){
    ADC1_Enable();
    
    ADC1_ChannelSelect(POT_FOOT);
    ADC1_SoftwareTriggerEnable();
    
    //Provide Delay
    for(adc_delay_counter=0;adc_delay_counter <1000;adc_delay_counter++) {}
    
    ADC1_SoftwareTriggerDisable();
    while(!ADC1_IsConversionComplete(POT_FOOT));
    // 12bit ADC resolution:
    conversion.ADC_Word = (ADC1_ConversionResultGet(POT_FOOT));

    if(conversion.ADC_Word>ZERO_REF){
        ema_s = (EMA_A * conversion.ADC_Word) + ((1-EMA_A) * ema_s);
        conversion.ADC_Word = ema_s;
    }

    if((conversion.ADC_Word - prev_conversion.ADC_Word) <= 250)

        conversion.ADC_Word = prev_conversion.ADC_Word;
    else
        prev_conversion.ADC_Word = conversion.ADC_Word;  

    if(conversion.ADC_Word <= ZERO_REF  )
        conversion.ADC_Word = 0;

    else if(conversion.ADC_Word - ZERO_REF <= STEP) 
//        conversion.ADC_Word = 51;
        conversion.ADC_Word = 0;

    else if(conversion.ADC_Word - ZERO_REF <= STEP*2)
        conversion.ADC_Word = 102;

    else if(conversion.ADC_Word - ZERO_REF <= STEP*3)
        conversion.ADC_Word = 153;

    else if(conversion.ADC_Word - ZERO_REF <= STEP*4)
        conversion.ADC_Word = 204;

    else if(conversion.ADC_Word - ZERO_REF <= STEP*5)
        conversion.ADC_Word = 255;

    else if(conversion.ADC_Word - ZERO_REF <= STEP*6)
        conversion.ADC_Word = 306;      

    else if(conversion.ADC_Word - ZERO_REF <= STEP*7)
        conversion.ADC_Word = 357;   

    else if(conversion.ADC_Word - ZERO_REF <= STEP*8)
        conversion.ADC_Word = 408;   

    else if(conversion.ADC_Word - ZERO_REF <= STEP*9)
        conversion.ADC_Word = 459;   

    else if(conversion.ADC_Word - ZERO_REF <= STEP*10)
        conversion.ADC_Word = 510;   

    else if(conversion.ADC_Word - ZERO_REF <= STEP*11)
        conversion.ADC_Word = 561;   

    else if(conversion.ADC_Word - ZERO_REF <= STEP*12)
        conversion.ADC_Word = 612;   

    else if(conversion.ADC_Word - ZERO_REF <= STEP*13)
        conversion.ADC_Word = 663;   

    else if(conversion.ADC_Word - ZERO_REF <= STEP*14)
        conversion.ADC_Word = 714;   

    else if(conversion.ADC_Word - ZERO_REF <= STEP*15)
        conversion.ADC_Word = 765;   

    else if(conversion.ADC_Word - ZERO_REF <= STEP*16)
        conversion.ADC_Word = 816;   

    else if(conversion.ADC_Word - ZERO_REF <= STEP*17)
        conversion.ADC_Word = 867;   

    else if(conversion.ADC_Word - ZERO_REF <= STEP*18)
        conversion.ADC_Word = 918;   

    else if(conversion.ADC_Word - ZERO_REF <= STEP*19)
        conversion.ADC_Word = 969;   

    else if(conversion.ADC_Word - ZERO_REF >  STEP*19)
        conversion.ADC_Word = 1023;   

    ADC1_Disable();
}



void CanMessageCheck(void){
    // Receive CAN messages and store their data
    RECmsg.data = data_rec_message;
    if(CAN1_Receive(&RECmsg)){
        if(RECmsg.msgId==0x185){
            counter_can_tx_100ms = 0;
            flags.can_synced = true;
        }
        
        if(RECmsg.msgId==0x133){
            if((RECmsg.data[1] & 0b11110000) == 0b11110000){
            displayed_steeringw_installed = true;
            VcuState_A.VCUBits_1 = (RECmsg.data[0] & 0b11001111) | (VcuState_A.VCUBits_1 & 0b00110000);
            VcuState_B.VCUBits_2 = (RECmsg.data[1] & 0b00000011) | (VcuState_B.VCUBits_2 & 0b11111100);
            }
            
//            VcuState_A.ACC              =   RECmsg.data[0] & 0b00000001;
//            VcuState_A.DRIVE            =   RECmsg.data[0] & 0b00000010;  
//            VcuState_A.REVERSE          =   RECmsg.data[0] & 0b00000100;
//            VcuState_A.LAP              =   RECmsg.data[0] & 0b00001000;
//            VcuState_A.PSD_CONT              =   RECmsg.data[0] & 0b01000000;
//            VcuState_A.MOD              =   RECmsg.data[0] & 0b10000000;
//            VcuState_B.TS_L             =   RECmsg.data[1] & 0b00000001;
//            VcuState_B.TS_R             =   RECmsg.data[1] & 0b00000010;
        }
        
        if(RECmsg.msgId==0x10){
            if(1 & (RECmsg.data[0])){
                IO_AUT_LIGHT_SetHigh();
            }else{
                IO_AUT_LIGHT_SetLow();
            }
        }
    
    }
}

//void McCommandUpdate(void){
//    MC_1.DIRECTION              =   VcuState_A.REVERSE;
//    
//    if(VcuState_A.DRIVE | VcuState_A.REVERSE)
//    {
//        MC_1.DRIVE                  =   1;
//    }
//    else
//    {
//        MC_1.DRIVE                  =   0;
//    }
//    if(VcuState_A.REVERSE && conversion.ADC_Word > 716){
//        conversion.ADC_Word = 716;
//    }
//    
//    MC_1.MODE                   =   1;
//    MC_1.BOOST                  =   0;
//    MC_1.RPM_FACTOR             =   1;
//    MC_2.ZERO                   =   0;
//    
//    MC_REF.HighByte             =   conversion.ADC_Word/256; 
//    MC_REF.LowByte              =   conversion.ADC_Word%256;  
//}

//void McCommandUpdate(void){
//    mc_duty_cycle = (double)conversion.ADC_Word/1023;
//    if(VcuState_A.REVERSE){
//        mc_duty_cycle = mc_duty_cycle * -1;
//        
//    }
//}

//void CanMcCommand(void){
//    // Send CAN message about MC Command
//    if(VcuState_A.DRIVE || VcuState_A.REVERSE ){
//
//        data_mc[0] = MC_1.MCBits_1;
//        data_mc[1] = MC_2.MCBits_2;
//        data_mc[2] = MC_REF.HighByte;
//        data_mc[3] = MC_REF.LowByte;
//
//        CAN1_OperationModeSet(CAN_NORMAL_2_0_MODE);
//
//        if(VcuState_A.MC_OW == 1) {MCmsg.msgId = 0x251;}
//        else{MCmsg.msgId = 0x200;}
//        
//
//        MCmsg.field.frameType = CAN_FRAME_DATA;
//        MCmsg.field.idType = CAN_FRAME_STD;
//        MCmsg.field.dlc = CAN_DLC_4;
//        MCmsg.data = data_mc;
//
//        CAN1_Transmit(CAN_PRIORITY_HIGH, &MCmsg);
//    }
//    
//    // END - Send CAN message about MC Command
//}

void CanMcCommand(void){
    // Send CAN message about MC Command
     mc_duty_cycle = (double)conversion.ADC_Word/1023;
    if(VcuState_A.REVERSE){
        mc_duty_cycle = mc_duty_cycle * -1;    
    }
     
    mc_data_buffer = mc_duty_cycle * 100000;
    data_mc[0] = mc_data_buffer >> 24;
    data_mc[1] = mc_data_buffer >> 16;
    data_mc[2] = mc_data_buffer >> 8;
    data_mc[3] = mc_data_buffer; 
     
     
//    if(VcuState_A.MC_OW){
//        MC_1.DIRECTION              =   VcuState_A.REVERSE;
//
//        if(VcuState_A.DRIVE | VcuState_A.REVERSE){
//            MC_1.DRIVE                  =   1;
//        }else{
//            MC_1.DRIVE                  =   0;
//        }
//        
//        MCmsg.msgId = 0x130;
//        MCmsg.field.frameType = CAN_FRAME_DATA;
//        MCmsg.field.idType = CAN_FRAME_STD;
//        MCmsg.field.dlc = CAN_DLC_1;
//        MCmsg.data = &MC_1.MCBits_1;
//        
//        CAN1_Transmit(CAN_PRIORITY_HIGH, &MCmsg);
//    }else{
    if(!VcuState_A.MC_OW){
        if(VcuState_A.DRIVE || VcuState_A.REVERSE ){

            CAN1_OperationModeSet(CAN_NORMAL_2_0_MODE);

            MCmsg.msgId = 0xA51;
            MCmsg.field.frameType = CAN_FRAME_DATA;
            MCmsg.field.idType = CAN_FRAME_EXT;
            MCmsg.field.dlc = CAN_DLC_4;
            MCmsg.data = data_mc;

            CAN1_Transmit(CAN_PRIORITY_HIGH, &MCmsg);
        }
    }
    
    // END - Send CAN message about MC Command
}

void PortStatusUpdate(void){

    VcuState_A.DC_ENABLE        =   IO_DC_ENABLE_GetValue();
    
    //if (IO_DC_ENABLE_GetValue() == prev_DC_EN) { VcuState_A.DC_ENABLE = 0; }
    VcuState_A.MC_OW            =   IO_MC_OW_GetValue();
    if(!displayed_steeringw_installed){
    VcuState_A.ACC              =   IO_ACC_GetValue();
    VcuState_A.DRIVE            =   IO_DRIVE_GetValue();  
    VcuState_A.REVERSE          =   IO_REVERSE_GetValue();
    VcuState_A.LAP              =   IO_LAP_GetValue();
    VcuState_A.SPD_CONT         =   IO_SPEED_CONROL_GetValue();
    VcuState_A.MOD              =   IO_MOD_GetValue();
    VcuState_B.TS_L             =   IO_TS_L_GetValue();
    VcuState_B.TS_R             =   IO_TS_R_GetValue();
    }
    
//    //TESTING
//        VcuState_A.REVERSE          =   1;
//        VcuState_A.ACC              =   1;
    prev_DC_EN = VcuState_A.DC_ENABLE;
}

void DebounceProtectedPortStatusUpdate(void){
    VcuState_B.AUT              =   IO_AUT_GetValue();
    VcuState_B.RELAY_NC         =   IO_RELAY_NC_GetValue();
    VcuState_B.RELAY_NO         =   IO_RELAY_NO_GetValue();
    VcuState_B.HAZARD           =   IO_HAZARD_GetValue();
    VcuState_B.BRAKE            =   IO_BRAKE_GetValue();
    VcuState_B.LIGHTS           =   IO_LIGHTS_GetValue();
    VcuState_C.WIPER            =   IO_WIPER_GetValue();
    flags.pgood                 =   IO_PGOOD_GetValue();
    
    if(!VcuState_B.RELAY_NC && VcuState_B.RELAY_NO){
        VcuState_A.ACC              =   0;
        VcuState_A.DRIVE            =   0;  
        VcuState_A.REVERSE          =   0;
    }
    
}

void CanVcuState(void){
    // Send CAN message about VCU state
//    if(flags.relay_on){
//        VcuState_A.ACC              =   0;
//        VcuState_A.DRIVE            =   0;  
//        VcuState_A.REVERSE          =   0;
//    }
    vcu_throttle = (double)conversion.ADC_Word/1023;
     
    vcu_data_buffer = vcu_throttle * 100000;
    data_vcu_state[2] = vcu_data_buffer >> 24;
    data_vcu_state[3] = vcu_data_buffer >> 16;
    data_vcu_state[4] = vcu_data_buffer >> 8;
    data_vcu_state[5] = vcu_data_buffer; 
    
    data_vcu_state[0] = VcuState_A.VCUBits_1;
    data_vcu_state[1] = VcuState_B.VCUBits_2;
//    data_vcu_state[3] = CanCounter;
    
    CAN1_OperationModeSet(CAN_NORMAL_2_0_MODE);
    VCUmsg.msgId = 0x129;
    VCUmsg.field.frameType = CAN_FRAME_DATA;
    VCUmsg.field.idType = CAN_FRAME_STD;
    VCUmsg.field.dlc = CAN_DLC_6;
    VCUmsg.data = data_vcu_state;
            
    CAN1_Transmit(CAN_PRIORITY_HIGH, &VCUmsg);
    
    // END - Send CAN message about VCU state
}

void StateMachineUpdate(void){
    
    if(!VcuState_A.DRIVE && !VcuState_A.REVERSE){
        current_state = Neutral;
    }else if(!VcuState_A.MC_OW && conversion.ADC_Word > 0){
        if(VcuState_A.DRIVE){
            current_state = Drive_Pedal;
        }else if(VcuState_A.REVERSE){
            current_state = Reverse_Pedal;
        }
    }else if(!VcuState_A.MC_OW && VcuState_A.ACC && conversion.ADC_Word == 0){
        if(VcuState_A.DRIVE){
            current_state = Automatic_Acc;
        }else if(VcuState_A.REVERSE){
            current_state = Automatic_Dec;
        }
    }else{
        current_state = Neutral;
    }
    if(prev_state != Neutral && current_state == Neutral){
        conversion.ADC_Word = 0;
        prev_ref_conversion.ADC_Word = 0;
//        McCommandUpdate();
        CanMcCommand();
    }
    prev_state = current_state;
}

void CalculateMCRef(void){

    conversion.ADC_Word = 1023;
}

void RateLimiter(void){
//    acceleration_rate = conversion.ADC_Word;
//    acceleration_rate -= prev_ref_conversion.ADC_Word;
    if(2000+conversion.ADC_Word-prev_ref_conversion.ADC_Word > 2000+RATE_LIMIT_UP){
        conversion.ADC_Word = prev_ref_conversion.ADC_Word + RATE_LIMIT_UP;
    }else if(2000+conversion.ADC_Word-prev_ref_conversion.ADC_Word < 2000-RATE_LIMIT_DOWN){
        conversion.ADC_Word = prev_ref_conversion.ADC_Word - RATE_LIMIT_DOWN;
    }
        
//    if(conversion.ADC_Word>1023){
//        conversion.ADC_Word = 1023;
//    }
    prev_ref_conversion.ADC_Word = conversion.ADC_Word;
}


void GoToSleep(void){
    //add lines if necessary
    //RCONbits.SLEEP = 0;
    RCONbits.IDLE = 0;
    RCONbits.WDTO = 0;
    //Disable DMA interrupts
    IPC1bits.DMA0IP = 0;
    IPC6bits.DMA2IP = 0;
    //ADC disabled in idle ADSIDL = 1
    Idle();   
}

void ReturnFromSleep(void){
    if(RCONbits.IDLE == 1){
        RCONbits.IDLE = 0;
        if(RCONbits.WDTO == 1){
            RCONbits.WDTO = 0;
        }
        ClrWdt();
        IPC1bits.DMA0IP = 1;
        IPC6bits.DMA2IP = 1;
    }
    //add lines if necessary
}

void WiperActions(void){
    switch(wiper_state){
        case 0: //STBY
            if(VcuState_C.WIPER == 1){
                wiper_state = 1;
            }
            break;
        case 1: //READY
            //Enable Converter
            IO_5V_CONV_EN_SetHigh();
            //Start PWM module
            PTCON = 0x8000;
            //Start Timer
            flags.wiper_on = true;
            if(flags.wiper_move == true)
            {
                wiper_state = 2;
                flags.wiper_move = false;
            }
            break;
        case 2: // Right
            PDC2 = WIPER_LIMIT_RIGHT;
            if(VcuState_C.WIPER == 0)
            {
                wiper_state = 4;
            }
            if(flags.wiper_move == true)
            {
                wiper_state = 3;
                flags.wiper_move = false;
            }
            break;
        case 3: // Left
            PDC2 = WIPER_LIMIT_LEFT;
            if(VcuState_C.WIPER == 0)
            {
                wiper_state = 4;
            }
            if(flags.wiper_move == true)
            {
                wiper_state = 2;
                flags.wiper_move = false;
            }
            break; 
        case 4: // Center and ready to SW OFF
            if(flags.wiper_move == true)
            {
                PDC2 = WIPER_WINDSCREEN_CENTER;
                flags.wiper_move = false;
                wiper_state = 5;
            }
        case 5: // ALL OFF
            if(flags.wiper_move == true){
                //Turn OFF PWM Module
                PTCON = 0x0000;
                //Disable Wiper Timer Counter
                flags.wiper_on = false;
                flags.wiper_move = false;
                //Disable 5V Converter
                IO_5V_CONV_EN_SetLow();
                wiper_state = 0;
            }
            break;
        default:
            break;
    }
}

/**
 End of File
*/